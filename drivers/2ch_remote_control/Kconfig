## drivers/2ch_remote_control/Kconfig
```kconfig
# Copyright (c) 2024 Nordic Semiconductor ASA
# SPDX-License-Identifier: Apache-2.0

menuconfig 2CH_REMOTE_CONTROL
	bool "2ch remote-control driver"
	help
	  This option enables the 2ch remote-control custom driver class.

if 2CH_REMOTE_CONTROL

config 2CH_REMOTE_CONTROL_INIT_PRIORITY
	int "2ch remote control device drivers init priority"
	default KERNEL_INIT_PRIORITY_DEVICE
	help
	  2ch remote control device drivers init priority.

module = 2CH_REMOTE_CONTROL
module-str = 2ch_remote_control
source "subsys/logging/Kconfig.template.log_config"

rsource "Kconfig.gpio_led"

endif # 2CH_REMOTE_CONTROL
```

## drivers/Kconfig
```kconfig
# Copyright (c) 2021 Nordic Semiconductor ASA
# SPDX-License-Identifier: Apache-2.0

menu "Drivers"
rsource "2ch_remote_control/Kconfig"
# rsource "blink/Kconfig"
# rsource "sensor/Kconfig"
endmenu
```

## lib/rc_car/Kconfig
```kconfig
# Copyright (c) 2021, Legrand North America, LLC.
# SPDX-License-Identifier: Apache-2.0

config RC_CAR
	bool "Support for the remote-contoll car library"
	help
	  This option enables the 'rc_car' library

config RC_CAR_GET_VALUE_DEFAULT
	int "custom_get_value() default return value"
	depends on RC_CAR
	default 0
	help
	  This option primarily exists as an example of a library Kconfig
	  setting.

	  This option specifies the value for custom_get_value() to return
	  when the input parameter is zero. (Otherwise the function returns the
	  input parameter value.)

if RC_CAR

module = RC_CAR
module-str = rc_car
source "subsys/logging/Kconfig.template.log_config"

endif # RC_CAR
```
