## drivers/2ch_remote_controll/Kconfig
```kconfig
# Copyright (c) 2024 Nordic Semiconductor ASA
# SPDX-License-Identifier: Apache-2.0

menuconfig 2CH_REMOTE_CONTROLL
	bool "2ch remote-controll driver"
	help
	  This option enables the 2ch remote-controll custom driver class.

if 2CH_REMOTE_CONTROLL

config 2CH_REMOTE_CONTROLL_INIT_PRIORITY
	int "2ch remote controll device drivers init priority"
	default KERNEL_INIT_PRIORITY_DEVICE
	help
	  2ch remote controll device drivers init priority.

module = 2CH_REMOTE_CONTROLL
module-str = 2ch_remote_controll
source "subsys/logging/Kconfig.template.log_config"

rsource "Kconfig.gpio_led"

endif # 2CH_REMOTE_CONTROLL
```

## dts/bindings/2ch_remote_controll/remote-controll-gpio-2ch.yaml
```yaml
# Copyright (c) 2024 Nordic Semiconductor ASA
# SPDX-License-Identifier: Apache-2.0

description: |
  A generic binding for a GPIO-controlled 2-channel remote control. Note that this binding
  has no vendor prefix, as it does not target a specific device or vendor.

  Example definition in devicetree:

    remote-controll-gpio-2ch {
        compatible = "remote-controll-gpio-2ch";
        left-gpios = <&gpio0 0 GPIO_ACTIVE_HIGH>;
        right-gpios = <&gpio0 1 GPIO_ACTIVE_HIGH>;
    };

compatible: "remote-controll-gpio-2ch"

include: base.yaml

properties:
  left-gpios:
    type: phandle-array
    required: true
    description: GPIO-controlled left channel.

  right-gpios:
    type: phandle-array
    required: true
    description: GPIO-controlled right channel.

  # blink-period-ms:
  #   type: int
  #   description: Initial blinking period in milliseconds.
```

## tests/lib/custom/testcase.yaml
```yaml
common:
  tags: extensibility
  integration_platforms:
    - custom_plank
    - qemu_cortex_m0
    - esp32_devkitc/esp32/procpu
tests:
  lib.custom: {}
  lib.custom.non_default:
    extra_args: CONFIG_CUSTOM_GET_VALUE_DEFAULT=6
```
